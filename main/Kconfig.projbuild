## main/Kconfig.projbuild
```kconfig
menu "Zigbee Network Co-processor"

    choice NCP_BUS_MODE
        bool "Host Connection Mode"
        default NCP_BUS_MODE_UART
        help
            Select which mode does the device connection with the host, support UART/USB.

        config NCP_BUS_MODE_UART
            bool "UART"
        config NCP_BUS_MODE_USB
            bool "USB"
    endchoice

    config NCP_BUS_MODE
        int
        default 0 if NCP_BUS_MODE_UART
        default 1 if NCP_BUS_MODE_USB

    if NCP_BUS_MODE_UART
        config NCP_BUS_UART_BAUD_RATE
            int 
            default 115200
            range 9600 891200
            prompt "UART baud rate"
            help
                Set UART baud rate.
        
        config NCP_BUS_UART_BYTE_SIZE
            int 
            default 3
            range 0 3
            prompt "UART word length"
            help
                Set UART word length are defined as follows:

                - 0x0: 5bits
                - 0x1: 6bits
                - 0x2: 7bits
                - 0x3: 8bits

        config NCP_BUS_UART_STOP_BITS
            int 
            default 1
            range 1 3
            prompt "UART stop bits"
            help
                Set UART stop bits are defined as follows:

                - 0x1, 1bit
                - 0x2, 1.5bits
                - 0x3, 2bits

        config NCP_BUS_UART_FLOW_CONTROL
            int 
            default 0
            range 0 3
            prompt "UART HW flow control mode"
            help
                Set UART HW flow control mode are defined as follows:

                - 0x0, disable hardware flow control
                - 0x1, enable RX hardware flow control (rts)
                - 0x2, enable TX hardware flow control (cts)
                - 0x3, enable hardware flow control
        
        config NCP_BUS_UART_NUM
            int
            range 0 2
            default 1
            prompt "UART number"
            help
                Set UART number.
        
        config NCP_BUS_UART_RX_PIN
            int 
            default -1
            range -1 30
            prompt "UART RX pin"
            help
                Set UART RX pin.
        
        config NCP_BUS_UART_TX_PIN
            int 
            default -1
            range -1 30
            prompt "UART TX pin"
            help
                Set UART TX pin.
        
        config NCP_BUS_UART_RTS_PIN
            int 
            default -1
            range -1 30
            prompt "UART rts pin"
            help
                Set UART rts pin.
        
        config NCP_BUS_UART_CTS_PIN
            int 
            default -1
            range -1 30
            prompt "UART cts pin"
            help
                Set UART cts pin.

    endif # NCP_BUS_MODE_UART

endmenu

menu "Zigbee"

    config ZB_ENABLED
        bool "Zigbee Enable"
        default n
        help
            Select this option to enable Zigbee and show the submenu with Zigbee configuration choices.

    choice ZB_DEVICE_TYPE
        prompt "Configure the Zigbee device type"
        depends on ZB_ENABLED
        default ZB_ZCZR
        help
            Configure the Zigbee device type

        config ZB_ZCZR
            bool "Zigbee Coordinator or Router device"
            help
                Select this to enable Zigbee Coordinator or Router.
           
        config ZB_ZED
            bool "Zigbee End Device"
            help
                Select this to enable Zigbee End Device.

        config ZB_ZGPD
            depends on SOC_IEEE802154_SUPPORTED
            bool "Zigbee Green power device"
            help
                Select this to enable Zigbee Green Power Device.

    endchoice

    choice ZB_RADIO_TYPE
        prompt "Configure the Zigbee radio type"
        depends on ZB_ENABLED
        default ZB_RADIO_NATIVE if SOC_IEEE802154_SUPPORTED
        default ZB_RADIO_SPINEL_UART

        config ZB_RADIO_NATIVE
            bool "Native 15.4 radio"
            help
                Select this to use the native 15.4 radio.

        config ZB_RADIO_SPINEL_UART
            bool "Connect to 15.4 radio via Radio Spinel UART"
            select OPENTHREAD_SPINEL_ONLY
            help
                Select this to connect to a Radio Co-Processor via Spinel UART.
    endchoice
    
    menu "Zigbee Example"
        depends on ZB_ENABLED

        config ZB_GP_ENABLED
            depends on (ZB_ZCZR || ZB_ZGPD) && SOC_IEEE802154_SUPPORTED
            bool "Zigbee Green Power enable"
            default y if ZB_ZCZR
            help
                when enable green power, example would support as green power proxy(zczr default enabled), green power combo or just green power device.

    endmenu

    config ZB_DEBUG_MODE
        depends on ZB_ENABLED

        bool "Zigbee Debug Mode"
        default n
        help
            Setting Zigbee stack debug mode.
    
endmenu
```
